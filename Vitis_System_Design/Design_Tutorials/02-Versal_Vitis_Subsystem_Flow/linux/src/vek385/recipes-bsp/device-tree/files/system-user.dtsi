//
// Copyright (C) 2021-2022, Xilinx, Inc. All rights reserved.
// Copyright (C) 2022-2025, Advanced Micro Devices, Inc. All rights reserved.
// SPDX-License-Identifier: X11
//

//include/ "system-conf.dtsi"
/ {
  chosen {
    bootargs = "console=ttyAMA0  earlycon=pl011,mmio32,0xFF000000,115200n8 clk_ignore_unused root=/dev/mmcblk0p2 rw rootwait cma=512M";
    stdout-path = "serial0:115200n8";
  };
};

